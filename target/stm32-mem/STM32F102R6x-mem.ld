/* tvc-stm32 : STM32F102R6x-mem.ld generated by Lisp xml-config program */
/* Linker script to configure memory regions.
 *   FLASH.ORIGIN: starting address of flash
 *   FLASH.LENGTH: length of flash
 *   RAM.ORIGIN: starting address of RAM bank 0
 *   RAM.LENGTH: length of RAM bank 0
 */
MEMORY
{
   FLASH (rx)  : ORIGIN = 0x8000000, LENGTH = 32K
   SRAM  (rxw) : ORIGIN = 0x20000000, LENGTH = 6K
}
_estack = 0x20001800;   /* end of 6K RAM on AHB bus*/
/* Generate a link error if heap and stack don't fit into RAM */
Min_Heap_Size = 0;      /* required amount of heap  */
Min_Stack_Size = 0x400; /* required amount of stack */
