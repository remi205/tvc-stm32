/* tvc-stm32 : STM32F072RBx-mem.ld generated by Lisp xml-config program */
/* Linker script to configure memory regions.
 *   FLASH.ORIGIN: starting address of flash
 *   FLASH.LENGTH: length of flash
 *   RAM.ORIGIN: starting address of RAM bank 0
 *   RAM.LENGTH: length of RAM bank 0
 */
MEMORY
{
   FLASH (rx)  : ORIGIN = 0x8000000, LENGTH = 128K
   SRAM  (rxw) : ORIGIN = 0x20000000, LENGTH = 16K
}
_estack = 0x20004000;   /* end of 16K RAM on AHB bus*/
/* Generate a link error if heap and stack don't fit into RAM */
Min_Heap_Size = 0;      /* required amount of heap  */
Min_Stack_Size = 0x400; /* required amount of stack */
